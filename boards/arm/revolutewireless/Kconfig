## boards/arm/revolutewireless/Kconfig
```kconfig
# Revolute wireless
# Copyright (c) 2024 Tongtong Wang


if BOARD_REVOLUTEWIRELESS

config BOARD_ENABLE_DCDC
	bool "DCDC mode"
	select SOC_DCDC_NRF52X
	default y


endif # BOARD_REVOLUTE
```

## boards/revolutewireless/board.yml
```yaml
board:
  name: revolutewireless
  full_name: revolutewireless
  vendor: tongtonginc
  socs:
  - name: nrf52833
```

## boards/revolutewireless/revolutewireless_defconfig
```kconfig
# enable GPIO
CONFIG_GPIO=y

# clock control
CONFIG_CLOCK_CONTROL_NRF_K32SRC_RC=y
CONFIG_CLOCK_CONTROL_NRF_K32SRC_250PPM=y

# enable uart driver
CONFIG_SERIAL=y

# enable console
CONFIG_CONSOLE=y
CONFIG_UART_CONSOLE=y
CONFIG_BOOTLOADER_MCUBOOT=y
```

## boards/revopod/board.yml
```yaml
board:
  name: revopod
  full_name: Revopod
  vendor: tongtonginc
  socs:
  - name: nrf52840
```

## boards/revopod/revopod_defconfig
```kconfig
# enable GPIO
CONFIG_GPIO=y

# Enable MPU
CONFIG_ARM_MPU=y

# enable uart driver
CONFIG_SERIAL=y

# enable console
CONFIG_CONSOLE=y
CONFIG_UART_CONSOLE=y
```

## boards/testboard/board.yml
```yaml
board:
  name: testboard
  full_name: testboard
  vendor: tongtonginc
  socs:
  - name: nrf52833
```
